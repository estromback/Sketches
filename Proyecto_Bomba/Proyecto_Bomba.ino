/*

*/
#include <LiquidCrystal.h>

LiquidCrystal lcd(7, 8, 9, 10, 11, 12);


int boton = 2;
int Relay = 3;
bool estado = false ;
String Pump = "OFF" ;
unsigned long currentMillis = 0 ;
unsigned long previousMillis = 0 ;
bool valor ;
int horas = 0;
int minutos = 0;
int segundos = 0;
int decimas = 0;
long milisegundos = 0;

void setup()
  {
    pinMode (Relay , OUTPUT) ; // Relay como salida
    pinMode (boton , INPUT) ; //boton como entrada
    digitalWrite(Relay , estado) ; // Apagamos el LED al empezar
    lcd.begin(16, 2); // Fijar el numero de caracteres y de filas
    lcd.setCursor(1, 0);    // Ponte en la line 1, posicion 1
    lcd.print("Bomba: ") ;
  }

void loop()
  {
    bool valor = digitalRead(boton) ; // leemos el valor de boton en valor
    if ( valor == false )                               // esto es que han pulsado el botón
      {
        estado = ! estado ;                       // cambiamos el estado
        digitalWrite(Relay, estado) ;            // escribimos el nuevo valor
        delay(200);
        horas = 0;
        minutos = 0;
        segundos = 0;
        decimas = 0;
      }
    if (estado == true)
    {
      Pump = "ON ";
      //Print Time
      lcd.setCursor(0,1);
      if(horas < 10)
      {
        lcd.print("0");
      }
      lcd.print(horas);
      lcd.print(":");
      lcd.setCursor(3,1);
      if(minutos < 10)
      {
        lcd.print("0");
      }
      lcd.print(minutos);
      lcd.print(":");
      lcd.setCursor(6,1);
      if(segundos < 10)
      {
       lcd.print("0");
      }
      lcd.print(segundos);
    } 
     
    else
    {
     Pump = "OFF";
    }
    lcd.setCursor(8, 0);    // Ponte en la line 1, posicion 8
    lcd.print(Pump);
      
    milisegundos = millis();
    if(milisegundos % 100 == 0)
    { //Only enter if it has passed tenth of a second
      decimas++;
      if(decimas == 10)
        { //When it has passed 10 tenths of a second it count one second
          decimas = 0;
          segundos++;
        }
      if(segundos == 60)
        { //When it has passed 60 seconds it count one minute
        segundos = 0;
        minutos++;
        }
      if(minutos == 60)
        { //When it has passed 60 minutes it count one hour
          minutos = 0;
          horas++;
        }
    }
  }



